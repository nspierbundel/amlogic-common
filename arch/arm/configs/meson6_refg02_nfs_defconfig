## arch/arm/configs/meson6_refg02_nfs_defconfig
```kconfig
CONFIG_EXPERIMENTAL=y
# CONFIG_LOCALVERSION_AUTO is not set
# CONFIG_SWAP is not set
CONFIG_SYSVIPC=y
CONFIG_BSD_PROCESS_ACCT=y
CONFIG_RCU_TRACE=y
CONFIG_IKCONFIG=y
CONFIG_IKCONFIG_PROC=y
CONFIG_CGROUPS=y
CONFIG_CGROUP_FREEZER=y
CONFIG_CGROUP_CPUACCT=y
CONFIG_RESOURCE_COUNTERS=y
CONFIG_CGROUP_SCHED=y
# CONFIG_FAIR_GROUP_SCHED is not set
CONFIG_RT_GROUP_SCHED=y
CONFIG_BLK_DEV_INITRD=y
CONFIG_ASHMEM=y
# CONFIG_AIO is not set
CONFIG_EMBEDDED=y
# CONFIG_VM_EVENT_COUNTERS is not set
CONFIG_MODULES=y
CONFIG_MODULE_UNLOAD=y
# CONFIG_BLK_DEV_BSG is not set
CONFIG_BLK_DEV_INTEGRITY=y
# CONFIG_IOSCHED_CFQ is not set
CONFIG_ARCH_MESON6=y
CONFIG_MESON_SUSPEND=y
CONFIG_SUSPEND_WATCHDOG=y
CONFIG_SCREEN_ON_EARLY=y
CONFIG_MESON_LEGACY_REGISTER_API=y
CONFIG_MESON_CPU_TEMP_SENSOR=y
CONFIG_MESON_L2CC_OPTIMIZE=y
CONFIG_MESON_L2CC_DLF=y
CONFIG_MESON_L2CC_STANDBY=y
CONFIG_MESON_CUSTOM_BOARD_SUPPORT=y
# CONFIG_MACH_MESON6_SKT is not set
# CONFIG_MACH_MESON6_REF is not set
CONFIG_ARM_THUMBEE=y
CONFIG_ARM_ERRATA_754322=y
CONFIG_ARM_ERRATA_764369=y
CONFIG_ARM_ERRATA_775420=y
CONFIG_NO_HZ=y
CONFIG_HIGH_RES_TIMERS=y
CONFIG_SMP=y
CONFIG_NR_CPUS=2
CONFIG_AEABI=y
# CONFIG_OABI_COMPAT is not set
CONFIG_HIGHMEM=y
CONFIG_CMDLINE="console=ttyS0,115200n8 rw mem=1024M rootwait nohlt a9_clk=800M clk81=187500000 root=/dev/nfs nfsroot=192.168.10.250:/var/lib/tftpboot/nfs ip=dhcp init=/sbin/init hdmitx=true mac=00:0d:fe:59:a0:8e"
CONFIG_CMDLINE_FORCE=y
CONFIG_CPU_IDLE=y
CONFIG_VFP=y
CONFIG_NEON=y
CONFIG_BINFMT_MISC=y
CONFIG_WAKELOCK=y
CONFIG_FB_EARLYSUSPEND=y
CONFIG_PACKET=y
CONFIG_UNIX=y
CONFIG_NET_KEY=y
CONFIG_INET=y
CONFIG_IP_ADVANCED_ROUTER=y
CONFIG_IP_MULTIPLE_TABLES=y
CONFIG_IP_PNP=y
CONFIG_IP_PNP_DHCP=y
CONFIG_IP_PNP_BOOTP=y
CONFIG_IP_PNP_RARP=y
# CONFIG_INET_XFRM_MODE_TRANSPORT is not set
# CONFIG_INET_XFRM_MODE_TUNNEL is not set
# CONFIG_INET_XFRM_MODE_BEET is not set
# CONFIG_INET_LRO is not set
# CONFIG_IPV6 is not set
# CONFIG_ANDROID_PARANOID_NETWORK is not set
# CONFIG_NET_ACTIVITY_STATS is not set
CONFIG_CFG80211=y
CONFIG_CFG80211_WEXT=y
CONFIG_MAC80211=y
CONFIG_AML_REG_DEBUG=y
CONFIG_I2C_AML=y
CONFIG_SARADC_AM=y
CONFIG_AM_REMOTE=y
CONFIG_ADC_KEYPADS_AM=y
CONFIG_KEY_INPUT_CUSTOM_AM=y
CONFIG_AM_GPIO=y
CONFIG_AM_DEBUG=y
CONFIG_AM_SENSORS=y
CONFIG_USB_DWC_OTG_HCD=y
CONFIG_CARDREADER=y
# CONFIG_MMC_AML is not set
CONFIG_AMLOGIC_SPI_NOR=y
CONFIG_AM_NAND=y
# CONFIG_AML_NFTL is not set
CONFIG_AM_ETHERNET=y
CONFIG_AM_ETHERNET_DEBUG_LEVEL=0
CONFIG_AM_WIFI=y
CONFIG_AM_WIFI_USB=y
CONFIG_RTL8XXX_CU_USB_WIFI=y
CONFIG_AM_VIDEO=y
CONFIG_AM_VDEC_H264MVC=y
# CONFIG_AM_LCD_OUTPUT is not set
CONFIG_FB_AM=y
CONFIG_FB_OSD2_DEFAULT_WIDTH=1920
CONFIG_FB_OSD2_DEFAULT_HEIGHT=1080
CONFIG_FB_OSD2_DEFAULT_WIDTH_VIRTUAL=1920
CONFIG_FB_OSD2_DEFAULT_HEIGHT_VIRTUAL=2160
CONFIG_FB_OSD1_DEFAULT_BITS_PER_PIXEL=32
CONFIG_FB_OSD1_DEFAULT_WIDTH=1920
CONFIG_FB_OSD1_DEFAULT_HEIGHT=1080
CONFIG_FB_OSD1_DEFAULT_WIDTH_VIRTUAL=1920
CONFIG_FB_OSD1_DEFAULT_HEIGHT_VIRTUAL=2160
CONFIG_AM_GE2D=y
CONFIG_AM_LOGO=y
CONFIG_POST_PROCESS_MANAGER=y
CONFIG_POST_PROCESS_MANAGER_PPSCALER=y
CONFIG_POST_PROCESS_MANAGER_3D_PROCESS=y
CONFIG_DEINTERLACE=y
CONFIG_FREE_SCALE=y
CONFIG_MIX_FREE_SCALE=y
CONFIG_UMP_DEBUG=y
CONFIG_MALI400_DEBUG=y
CONFIG_UEVENT_HELPER_PATH="/sbin/mdev"
CONFIG_DEVTMPFS=y
CONFIG_DEVTMPFS_MOUNT=y
CONFIG_MTD_UBI=y
CONFIG_MTD_UBI_WL_THRESHOLD=4096
CONFIG_MTD_UBI_IGNORE_IO_BITFLIPS=y
CONFIG_BLK_DEV_LOOP=y
CONFIG_SCSI=y
CONFIG_BLK_DEV_SD=y
CONFIG_SCSI_MULTI_LUN=y
CONFIG_NETDEVICES=y
CONFIG_MII=y
# CONFIG_NETDEV_1000 is not set
# CONFIG_NETDEV_10000 is not set
CONFIG_INPUT_EVDEV=y
CONFIG_DEVPTS_MULTIPLE_INSTANCES=y
CONFIG_TTY_PRINTK=y
CONFIG_SPI_GPIO=y
CONFIG_SPI_SPIDEV=y
CONFIG_POWER_SUPPLY=y
# CONFIG_MFD_SUPPORT is not set
CONFIG_VIDEO_OUTPUT_CONTROL=y
CONFIG_FRAMEBUFFER_CONSOLE=y
# CONFIG_SND_SUPPORT_OLD_API is not set
CONFIG_SND_DUMMY=y
# CONFIG_SND_ARM is not set
# CONFIG_SND_SPI is not set
# CONFIG_SND_USB is not set
CONFIG_USB_ANNOUNCE_NEW_DEVICES=y
CONFIG_USB_DEVICEFS=y
# CONFIG_USB_DEVICE_CLASS is not set
CONFIG_USB_STORAGE=y
CONFIG_USB_SERIAL=y
CONFIG_UIO=y
CONFIG_UIO_PDRV=y
CONFIG_STAGING=y
CONFIG_ANDROID=y
CONFIG_ANDROID_BINDER_IPC=y
CONFIG_ANDROID_LOGGER=y
CONFIG_ANDROID_LOW_MEMORY_KILLER=y
CONFIG_EXT2_FS=y
CONFIG_EXT3_FS=y
CONFIG_EXT3_FS_POSIX_ACL=y
CONFIG_EXT3_FS_SECURITY=y
CONFIG_EXT4_FS=y
CONFIG_EXT4_FS_POSIX_ACL=y
CONFIG_EXT4_FS_SECURITY=y
CONFIG_EXT4_DEBUG=y
CONFIG_AUTOFS4_FS=y
CONFIG_FUSE_FS=y
CONFIG_CUSE=y
CONFIG_FSCACHE=y
CONFIG_FSCACHE_DEBUG=y
CONFIG_ISO9660_FS=y
CONFIG_JOLIET=y
CONFIG_ZISOFS=y
CONFIG_UDF_FS=y
CONFIG_MSDOS_FS=y
CONFIG_VFAT_FS=y
CONFIG_NTFS_FS=y
CONFIG_NTFS_RW=y
CONFIG_TMPFS=y
CONFIG_YAFFS_FS=y
CONFIG_YAFFS_DISABLE_TAGS_ECC=y
CONFIG_YAFFS_DISABLE_BLOCK_REFRESHING=y
CONFIG_YAFFS_DISABLE_BACKGROUND=y
CONFIG_UBIFS_FS=y
CONFIG_SQUASHFS=y
CONFIG_SQUASHFS_LZO=y
CONFIG_SQUASHFS_XZ=y
CONFIG_NFS_FS=y
CONFIG_NFS_V4=y
CONFIG_NFS_V4_1=y
CONFIG_ROOT_NFS=y
CONFIG_NFS_FSCACHE=y
CONFIG_NFS_USE_NEW_IDMAPPER=y
CONFIG_CIFS=y
CONFIG_CIFS_STATS=y
CONFIG_CIFS_STATS2=y
CONFIG_CIFS_WEAK_PW_HASH=y
CONFIG_CIFS_XATTR=y
CONFIG_CIFS_POSIX=y
CONFIG_CIFS_DEBUG2=y
CONFIG_PARTITION_ADVANCED=y
CONFIG_EFI_PARTITION=y
CONFIG_NLS_CODEPAGE_437=y
CONFIG_NLS_CODEPAGE_936=y
CONFIG_NLS_CODEPAGE_950=y
CONFIG_NLS_ISO8859_1=y
CONFIG_NLS_ISO8859_15=y
CONFIG_NLS_UTF8=y
CONFIG_PRINTK_TIME=y
CONFIG_DEBUG_KERNEL=y
CONFIG_LOCKUP_DETECTOR=y
# CONFIG_SCHED_DEBUG is not set
CONFIG_TIMER_STATS=y
CONFIG_DEBUG_SPINLOCK=y
CONFIG_DEBUG_MUTEXES=y
CONFIG_DEBUG_INFO=y
CONFIG_STRICT_DEVMEM=y
# CONFIG_ARM_UNWIND is not set
CONFIG_SECURITYFS=y
CONFIG_CRYPTO_AUTHENC=y
CONFIG_CRYPTO_CBC=y
CONFIG_CRYPTO_XTS=y
CONFIG_CRYPTO_SHA1=y
CONFIG_CRYPTO_SHA512=y
CONFIG_CRYPTO_WP512=y
CONFIG_CRYPTO_TWOFISH=y
CONFIG_CRC_CCITT=y
CONFIG_LIBCRC32C=y
```

## arch/arm/mach-meson3/Kconfig
```kconfig
if ARCH_MESON3

menu    "Meson Timer Setting"
config MESON_TIMERA
	bool "Enable EE Domain Timer A"
	default y
	help
		Enable EE Timer A . if enable the timer is 1Mhz
config MESON_TIMERB
	bool "Enable EE Domain Timer B"
	depends on !SMP || HAVE_ARM_TWD
	default n
	help
		Enable EE Timer B . if enable the timer is 1Mhz
config MESON_TIMERC
	bool "Enable EE Domain Timer C"
	default n
	help
		Enable EE Timer C . if enable the timer is 1Mhz
config MESON_TIMERD
	bool "Enable EE Domain Timer D"
	depends on !SMP || HAVE_ARM_TWD
	default n
	help
		Enable EE Timer D . if enable the timer is 1Mhz
endmenu

endif # ARCH_MESON3
```

## arch/arm/mach-meson3/Kconfig.boards
```kconfig
if ARCH_MESON3

config MACH_M3_SKT
	depends on ARCH_MESON3=y
	bool "Meson3 socket board"
	default y
	select I2C_AML
	select AML_HDMI_TX
	select FB_AM
	select FB_OSD2_CURSOR
	select SND_AML_M3
	select USB_DWC_OTG_HCD
	help
	  Support for Amlogic Meson3 socket board.

config MACH_M3_REF
	depends on ARCH_MESON3=y
	bool "Meson3 reference board"
	default y
	help
	  Support for Amlogic Meson3 reference development platform.

	  
config MACH_MESON3_8726M_SKT
	depends on ARCH_MESON3=y
	bool "MyGica A11"
	default y
	select GENERIC_GPIO
	select LEDS_GPIO
	select LEDS_GPIO_PLATFORM
	select LEDS_TRIGGER_DEFAULT_ON
	help
	  Support for Amlogic Meson3 reference development platform
	  
endif # ARCH_MESON3
```

## arch/arm/mach-meson6/Kconfig.boards
```kconfig
if ARCH_MESON6

config MACH_MESON6_SKT
	depends on ARCH_MESON6
	bool "Meson6 socket board"
	default y 
	help
          Support for Amlogic Meson6 socket board.

config MACH_MESON6_REF
	depends on ARCH_MESON6
	bool "Meson6 reference board"
	default y 
	help
          Support for Amlogic Meson6 reference development platform.

config MACH_MESON6_REFG02
	depends on ARCH_MESON6
	select SND_AML_SOC
	select SND_AML_M_DUMMY_CODEC
	bool "Meson6 reference board G02"
	default y 
	help
          Support for Amlogic Meson6 reference development platform.

endif # ARCH_MESON6
```
